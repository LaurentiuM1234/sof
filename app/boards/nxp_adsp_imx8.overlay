/*
 * Copyright 2023 NXP
 *
 * SPDX-License-Identifier: Apache-2.0
 */

/ {
	sai1: dai@59050000 {
 		compatible = "nxp,dai-sai";
		reg = <0x59050000 DT_SIZE_K(64)>;
		rx-fifo-watermark = <48>;
		tx-fifo-watermark = <1>;
		fifo-depth = <48>;
		interrupt-parent = <&master5>;
		interrupts = <28>;
		dai-index = <1>;
	};

	host_dma: dma {
		compatible = "nxp,sof-host-dma";
		dma-channels = <32>;
		#dma-cells = <0>;
	};

	edma0: dma@591f0000 {
		compatible = "nxp,edma";
		reg = <0x591f0000 (DT_SIZE_K(64) * 33)>;
		valid-channels = <14>, <15>;
		interrupt-parent = <&master5>;
		interrupts = <29>, <29>;
		#dma-cells = <0>;
	};
};
