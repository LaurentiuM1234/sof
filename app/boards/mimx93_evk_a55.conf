## app/boards/mimx93_evk_a55.conf
```kconfig
#
# Copyright 2023 NXP
#
# SPDX-License-Identifier: Apache-2.0

# Enable dynamic interrupts
CONFIG_DYNAMIC_INTERRUPTS=y

CONFIG_ARM64_VA_BITS_40=y
CONFIG_ARM64_PA_BITS_40=y

CONFIG_DCACHE_LINE_SIZE_DETECT=n
CONFIG_DCACHE_LINE_SIZE=64

CONFIG_IMX93_A55=y
CONFIG_TRACE=n

CONFIG_DAI=y
CONFIG_SAI_HAS_MCLK_CONFIG_OPTION=y
CONFIG_SAI_HAS_XCR4_CHMOD=y

CONFIG_DMA=y
CONFIG_DMA_NXP_EDMA_HAS_CHAN_MUX=y
CONFIG_DMA_NXP_EDMA_ENABLE_HALFMAJOR_IRQ=y

CONFIG_ZEPHYR_NATIVE_DRIVERS=y

CONFIG_LOG=y
CONFIG_LOG_ALWAYS_RUNTIME=y
CONFIG_LOG_FUNC_NAME_PREFIX_ERR=y

CONFIG_SHARED_INTERRUPTS=y
```
